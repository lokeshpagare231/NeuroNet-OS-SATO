## build/conf/bblayers.conf
```bitbake
# POKY_BBLAYERS_CONF_VERSION is increased each time build/conf/bblayers.conf
# changes incompatibly
POKY_BBLAYERS_CONF_VERSION = "2"

BBPATH = "${TOPDIR}"
BBFILES ?= ""

BBLAYERS ?= " \
  /home/heyy_sayee/poky/meta \
  /home/heyy_sayee/poky/meta-poky \
  /home/heyy_sayee/poky/meta-yocto-bsp \
  /home/heyy_sayee/poky/meta-neuronet \
  /home/heyy_sayee/poky/meta-openembedded/meta-oe \
  /home/heyy_sayee/poky/meta-openembedded/meta-python \
  /home/heyy_sayee/poky/meta-openembedded/meta-networking \
  /home/heyy_sayee/poky/meta-openembedded/meta-gnome \
  /home/heyy_sayee/poky/meta-openembedded/meta-multimedia \
  "
```
